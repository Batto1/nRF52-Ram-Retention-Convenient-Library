## CMakeLists.txt
```
# SPDX-License-Identifier: Apache-2.0

set(CONF_FILE "prj.conf")
set(CONF_FILE "${CONF_FILE};ram-ret.conf")

cmake_minimum_required(VERSION 3.20.0)

find_package(Zephyr REQUIRED HINTS $ENV{ZEPHYR_BASE})
project(nrf52_ram_retention_lib_demonstration)

target_sources(app PRIVATE src/main.c)

target_include_directories(app PUBLIC   ${CMAKE_CURRENT_SOURCE_DIR}/src/)
target_include_directories(app PUBLIC   ${CMAKE_CURRENT_SOURCE_DIR}/src/ram_retention/)
target_sources            (app PRIVATE  ${CMAKE_CURRENT_SOURCE_DIR}/src/ram_retention/ram_retention_utils.c)
```

## Kconfig
```
# Copyright (c) 2021 Nordic Semiconductor ASA
# SPDX-License-Identifier: Apache-2.0

mainmenu "Ram Retention"

config APP_RETENTION
	bool "State retention in system off"
	depends on SOC_COMPATIBLE_NRF52X
	help
	  On some Nordic chips this application supports retaining
	  memory while in system off.  Select this to enable the
	  feature.

source "Kconfig.zephyr"
```

## prj.conf
```kconfig
# nothing here
CONFIG_FPU=y
```

## ram-ret.conf
```kconfig
# Optional select RAM retention (nRF52 only)
CONFIG_APP_RETENTION=y
CONFIG_CRC=y
```

## src/main.c
```c
/**
 * @author Batto1
 * @brief  Example application for showcasing some functionality of nRF52 RAM retention utilities library. Note that some specific KConfig configurations are have to be made to enable RAM retention.
 * @date 	 26.03.2024
 *
 */


#include <inttypes.h>
#include <zephyr/kernel.h>
#include <zephyr/logging/log.h>

#include "ram_retention_utils.h"


LOG_MODULE_REGISTER(main_c, LOG_LEVEL_DBG);

RR_Init_Var_Ram_Retention(RamRetAtomic, g_cnt); 		// atomic RAM retention variable type declared, defined and initialized for RAM retention.

RamRetInt64_t g_poweredup_time = {0}; 				// int64_t data holding RAM retention type declared and defined. Note that it isn't automatically RAM retention initiallized like other variables, it'll be custom initialized for demonstration purposes.

// custom RAM retention variable type declared.
typedef struct myCustomData{
	int 		foo;
	float 	bar;
	char 	baz[20];
	// ...
}MyCustomData;

RamRetTypeDeclare(MyCustomData, RamRetMyCustomData); 		// type declaration for custom data.
RR_Init_Var_Ram_Retention(RamRetMyCustomData, g_custom); 	// custom RAM retention variable initialized for RAM retention.

int g_no_ram_ret_var = 0;

void main(void)
{
	for(int i = 0; i < 5; i++){
		(void)atomic_inc(&g_cnt.rr_var); // increment RAM retained atomic variable.
		RR_Var_Ram_Ret(RamRetAtomic, &g_cnt); // retain the variable after modifying it, otherwise changes won't be retained.

		k_busy_wait(100000); // wait 100msec.		
	}


	bool is_valid = RR_Var_Ram_Ret_Init(RamRetInt64t, g_poweredup_time); // initialized RAM retention variable.
	if(false == is_valid){					
		printk("Ram ret initialization error\n"); 	
	}	
	g_poweredup_time.rr_var += k_uptime_get();
	RR_Var_Ram_Ret(RamRetInt64t, &g_poweredup_time); // retain the variable after modifying it, otherwise changes won't be retained.


	g_custom.rr_var.foo += 5;
	g_custom.rr_var.bar += 5;
	RR_Var_Ram_Ret(RamRetMyCustomData, &g_custom); // retain the variable after modifying it, otherwise changes won't be retained.
	k_busy_wait(100000); // wait 100msec.


	g_no_ram_ret_var ++; 
	printk("RAM ret variables current values:\n");
	printk("g_cnt: %d\n", (int)atomic_get(&g_cnt.rr_var));
	printk("g_poweredup_time: %"PRId64"ms\n", g_poweredup_time.rr_var);
	printk("g_custom.rr_var.foo:%d  g_custom.rr_var.bar: %f\n", g_custom.rr_var.foo, g_custom.rr_var.bar);

	printk("\nint variable that is not RAM retained: %d\n", g_no_ram_ret_var);

	printk("Main end, restart board for observing RAM retention variables again.\n");
	printk("*******************************************");

	while(1);
}
```

## src/sys_init_utils.h
```c
/**
 * @brief       Built upon Zephyr Initialization infrastructure to simplify using system initialization and offer some related tools.
 * @author      Batto1
 * @date        of last modification: 26.03.2024
 * @warning     SYS_INIT is just some code working at the beginning of the main thread. Main thread exist whether user writes code block into it or not. Due to this, the priority and stacksize of main thread matters. For example, if a thread that is higher priority than main is started or signaled in one of the SYS_INIT functions, it will preempt main thread, thus the SYS_INIT tasks (if main isn't configured to be cooperative thread), so this situation should be considered.
 */


/**
 * @note Zephyr offers an infrastructure to call initialization code before main.
Such initialization calls can be registered using SYS_INIT() or SYS_INIT_NAMED() macros. By using a combination of initialization levels and priorities init sequence can be adjusted as needed. The available initialization levels are described, in order, below:

 * @defgroup  initialization_levels
        EARLY: Used very early in the boot process, right after entering the C domain (z_cstart()). This can be used in architectures and SoCs that extend or implement architecture code and use drivers or system services that have to be initialized before the Kernel calls any architecture specific initialization code.
        PRE_KERNEL_1: Executed in Kernel's initialization context, which uses the interrupt stack. At this point Kernel services are not yet available.
        PRE_KERNEL_2: Same as PRE_KERNEL_1.
        POST_KERNEL: Executed after Kernel is alive. From this point on, Kernel primitives can be used.
        APPLICATION: Executed just before application code (main).
        SMP: Only available if CONFIG_SMP is enabled, specific for SMP.

 * @defgroup initialization_priority
        can take a value in the range of 0 to 99. Note that it must be a decimal integer literal without leading zeroes or sign (e.g. 32), or must be an equivalent symbolic name (e.g. #define MY_INIT_PRIO 32). Symbolic expressions are not permitted (e.g. CONFIG_KERNEL_INIT_PRIORITY_DEFAULT + 5).
        Lower values correspond to higher priority.
*/

#ifndef SYS_INIT_UTILS_H
#define SYS_INIT_UTILS_H

#ifdef __cplusplus
extern "C" {
#endif

#include <zephyr/kernel.h>
#include <zephyr/init.h>
#include "user_common.h"        // under file named "common"


#define SYS_INIT_HIGHEST_PRIO 0   // sys init code with priority approaching to this values works earliest
#define SYS_INIT_LOWEST_PRIO  99  // sys init code with priority approaching to this values works latest

/**
 * @brief The kind of function pointer type that the SYS_INIT takes. You can define it as static.
*/
typedef int (*SYS_Init_Func_t)(const struct device *);


/**
 * @brief Simply establish a SYS_INIT code block. You don't need to provide a function name and must write the block of code composing with this macro (see @example).. This macro automatically creates a uniquely named initialization function.
 * @param   [in] level Initialization level      @defgroup   initialization_levels
 * @param   [in] prio  Initialization priority   @defgroup   initialization_priority
 * @warning The convenience of using this macro for easily defining SYS_INIT code blocks anywhere, rather than writing them to a common SYS_INIT function creates 16 byte overhead on the FLASH memory.
 * @note return function block with 0 to not get any warnings in the compilation phase.
 * @example 
            SYS_INIT_SIMPLE(APPLICATION, 50){
                printk("This will print before main!\n");
                return 0;
            }
*/
#define SYS_INIT_SIMPLE(level, prio)                 \
    static int u_CONCATENATE(__sys_init_func_, __LINE__ )(const struct device *dev);    \
    SYS_INIT(u_CONCATENATE(__sys_init_func_, __LINE__ ), level, prio);                  \
    static int u_CONCATENATE(__sys_init_func_, __LINE__ )(const struct device *dev)


/**
 * @brief Same macro as with the SYS_INIT_SIMPLE(level, prio) while only the naming is different for more convenient naming considerations and backwards compability. 
*/
#define SYS_INIT_EASY(level, prio) SYS_INIT_SIMPLE(level, prio)



/**
 * @brief Similar to SYS_INIT_SIMPLE: Simply establish a SYS_INIT code block where you also provide the function name. You must write the block of code composing with this macro (see @example). This macro automatically creates a initialization function with the user provided function name.
 * @param   [in] fn_name    Given name for the SYS_INIT() initialization function.
 * @param   [in] level      Initialization level      @defgroup   initialization_levels
 * @param   [in] prio       Initialization priority   @defgroup   initialization_priority
 * @warning The convenience of using this macro for easily defining SYS_INIT code blocks anywhere, rather than writing them to a common SYS_INIT function creates 16 byte overhead on the FLASH memory.
 * @note return function block with 0 to not get any warnings in the compilation phase.
 * @example 
            SYS_INIT_USER_NAMED(my_func, APPLICATION, 50)
            {
                printk("hi there\n");
                return 0;
            }
*/
#define SYS_INIT_USER_NAMED(fn_name, level, prio)        \
    static int u_CONCATENATE( , fn_name ) (const struct device *dev);     \
    SYS_INIT(u_CONCATENATE( , fn_name ), level, prio);                    \
    static int u_CONCATENATE( , fn_name ) (const struct device *dev)










#ifdef __cplusplus
}
#endif

#endif /* SYS_INIT_UTILS_H */
```

## src/user_common.h
```c
/**
 * @brief Common utilities
 * @author Batto1
 * @date of last modification: 31.01.2024
*/







#ifndef USER_COMMON_H
#define USER_COMMON_H

#ifdef __cplusplus
extern "C" {
#endif


/**
 * Related to workaround for order of macro expansion in C.
 * If you only use this, special macros like __COUNTER__, __LINE__, or __FILE__ get treated as literal string rather than the value they're
 * representing. To work around this, additional level of indirection by introducing another macro layer can be used. 
 * */
#define     _u_STRINGIFY(x) #x  /* @internal  you don't use this */
#define     u_STRINGIFY(x) _u_STRINGIFY(x) 

/* Macro expansion workaround */
// #define _u_MACRO_EXPANSION_WA(x) x
// #define u_MACRO_EXPANSION_WA(x) _u_MACRO_EXPANSION_WA(x)

/* Macro expansion workaround with concatenate*/
#define _u_CONCATENATE(x, y) x ## y
#define u_CONCATENATE(x, y) _u_CONCATENATE(x, y)


/* For creating unique names, concatenates __LINE__ and __COUNTER__ macros. */
#define LINE_AND_COUNTER u_CONCATENATE(u_CONCATENATE(__LINE__, _), __COUNTER__ )








#ifdef __cplusplus
}
#endif

#endif // END: USER_COMMON_H
```
